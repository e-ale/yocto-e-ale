## meta-e-ale-apps/conf/layer.conf
```bitbake
# We have a conf and classes directory, add to BBPATH
BBPATH .= ":${LAYERDIR}"

# We have recipes-* directories, add to BBFILES
BBFILES += "${LAYERDIR}/recipes-*/*/*.bb \
            ${LAYERDIR}/recipes-*/*/*.bbappend"

BBFILE_COLLECTIONS += "../yocto-e-ale/meta-e-ale-apps"
BBFILE_PATTERN_../yocto-e-ale/meta-e-ale-apps = "^${LAYERDIR}/"
BBFILE_PRIORITY_../yocto-e-ale/meta-e-ale-apps = "6"
```

## meta-e-ale-bsp/conf/machine/pocketbeagle.conf
```bitbake
#@TYPE: Machine
#@NAME: PocketBeagle machine
#@DESCRIPTION: Reference machine configuration for http://beagleboard.org/pocket for the E-ALE training sessions

include conf/machine/include/ti33x.inc

IMAGE_FSTYPES += "tar.bz2 jffs2 wic wic.bmap"
EXTRA_IMAGECMD_jffs2 = "-lnp "

WKS_FILE = "pocketbeagle-yocto.wks"
IMAGE_INSTALL_append = " kernel-devicetree kernel-image-zimage"
do_image_wic[depends] += "mtools-native:do_populate_sysroot dosfstools-native:do_populate_sysroot"
PREFERRED_PROVIDER_virtual/kernel = "linux-pocketbeagle"

MACHINE_EXTRA_RRECOMMENDS = " kernel-modules kernel-devicetree"

PREFERRED_PROVIDER_virtual/bootloader = "u-boot"
PREFERRED_PROVIDER_u-boot = "u-boot"

EXTRA_IMAGEDEPENDS += "u-boot"

# These are from yocto-bsp, but we are using ti3xx.inc
# DEFAULTTUNE ?= "cortexa8hf-neon"
# include conf/machine/include/tune-cortexa8.inc

SERIAL_CONSOLE = "115200 ttyO0"

KERNEL_IMAGETYPE = "zImage"
KERNEL_DEVICETREE = "am335x-pocketbeagle.dtb"
KERNEL_EXTRA_ARGS += "LOADADDR=${UBOOT_ENTRYPOINT}"

SPL_BINARY = "MLO"
UBOOT_SUFFIX = "img"
UBOOT_MACHINE = "am335x_pocketbeagle_defconfig"
UBOOT_ENTRYPOINT = "0x80008000"
UBOOT_LOADADDRESS = "0x80008000"

MACHINE_FEATURES = "usbgadget usbhost vfat"

IMAGE_BOOT_FILES ?= "u-boot.${UBOOT_SUFFIX} MLO"
```

## meta-e-ale-bsp/wic/pocketbeagle-yocto.wks
```
# short-description: Create SD card image for PocketBeagle
# long-description: Creates a partitioned SD card image for PocketBeagle.
# Boot files are located in the first vfat partition.

part /boot --source bootimg-partition --ondisk mmcblk0 --fstype=vfat --label boot --active --align 4 --size 16
part / --source rootfs --ondisk mmcblk --fstype=ext4 --label root --align 4
```

## meta-e-ale-distro/conf/bblayers.conf.sample
```bitbake
# LAYER_CONF_VERSION is increased each time build/conf/bblayers.conf
# changes incompatibly
LCONF_VERSION = "3"

BBPATH = "${TOPDIR}"
BBFILES ?= ""

BBLAYERS ?= " \
  ##OEROOT##/meta \
  ##OEROOT##/../yocto-e-ale/meta-e-ale-bsp \
  ##OEROOT##/../yocto-e-ale/meta-e-ale-distro \
  "
```

## meta-e-ale-distro/conf/distro/e-ale.conf
```bitbake
DISTRO = "e-ale"
DISTRO_NAME = "e-ale Linux"

DISTRO_VERSION = "1.0+snapshot-${DATE}"

E_ALE_DEFAULT_DISTRO_FEATURES = "systemd"

LAYER_CONF_VERSION ?= "2"

# Add ssh server so we can connect to system running this image remotely,
# add development tools (gcc, make, etc), and -dev packages for installed #packages.
E_ALE_DEFAULT_DISTRO_FEATURES += "ssh-server-openssh tools-sdk dev-pkgs"

DISTRO_FEATURES ?= "${DISTRO_FEATURES_DEFAULT} ${DISTRO_FEATURES_LIBC} ${E_ALE_DEFAULT_DISTRO_FEATURES}"

VIRTUAL-RUNTIME_init_manager = "systemd"

INHERIT += "uninative"

UNINATIVE_URL = "http://downloads.yoctoproject.org/releases/uninative/1.7/"
UNINATIVE_CHECKSUM[i686] ?= "de51bc9162b07694d3462352ab25f636a6b50235438c1b09440d7569e009123b"
UNINATIVE_CHECKSUM[x86_64] ?= "ed033c868b87852b07957a4400f3b744c00aef5d6470346ea1a59b6d3e03075e"
```
